## build/kunit_defconfig
```kconfig
# kernel configs
CONFIG_DEBUG_FS=y

# kunit configs
CONFIG_KUT_COLOURS=y
CONFIG_KUT_FS=y
```

## build/ut_defconfig
```kconfig
# project build configuration options

CONFIG_UT_COLOURS=y

CONFIG_SLW=y
CONFIG_SDP=y
CONFIG_VECTOR=y
```
